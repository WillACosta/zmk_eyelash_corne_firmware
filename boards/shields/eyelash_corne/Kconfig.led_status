## boards/shields/eyelash_corne/Kconfig.led_status
```kconfig
# Copyright (c) 2024 The ZMK Contributors
# SPDX-License-Identifier: MIT

menuconfig ZMK_LED_STATUS
    bool "LED-based keyboard status indicators"
    depends on ZMK_RGB_UNDERGLOW
    depends on SHIELD_EYELASH_CORNE_LEFT
    default y
    help
      Enable the LED status system for the Eyelash Corne left (central) half.
      Uses per-key RGB LEDs to indicate Bluetooth profile, pairing state,
      host connection, split connection, and battery level.
      LEDs are off by default and only illuminate during brief event-driven
      animations, keeping power consumption minimal.
```

## modules/zmk-heatmap/Kconfig
```kconfig
menu "ZMK Heatmap"

config ZMK_HEATMAP
	bool "Enable ZMK Heatmap key event logging"
	default y
	imply ZMK_USB_LOGGING
	help
	  Enable logging of key matrix position press events for heatmap generation.

config ZMK_HEATMAP_LOG_LEVEL
	int "ZMK Heatmap log level"
	default 3
	depends on ZMK_HEATMAP
	help
	  Log level for ZMK Heatmap module (3 = LOG_LEVEL_INF).

endmenu
```
